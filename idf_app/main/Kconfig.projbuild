## idf_app/main/Kconfig.projbuild
```kconfig
menu "HiPhi Dial Defaults"

config RK_DEFAULT_SSID
    string "Default WiFi SSID"
    default ""

config RK_DEFAULT_PASS
    string "Default WiFi Password"
    default ""

config RK_DEFAULT_BRIDGE_BASE
    string "Default Bridge Base URL (leave empty to require mDNS or manual config)"
    default ""

config RK_DEFAULT_ZONE_ID
    string "Default Roon zone ID (leave empty to require picking one)"
    default ""
    help
        Used when no zone_id is stored in NVS (fresh device, or a config
        reset) - the device matches this ID against the live zone list
        from the bridge instead of falling back to whatever zone happens
        to be listed first. Overridden by whatever zone_id ends up
        actually stored in NVS (e.g. via the device's config page).

endmenu

menu "Display Sleep Settings"

config RK_DISPLAY_DIM_TIMEOUT_SEC
    int "Display dim timeout (seconds)"
    default 30
    range 5 300
    help
        Time in seconds before dimming the display backlight.
        Set to 0 to disable dimming.

config RK_DISPLAY_SLEEP_TIMEOUT_SEC
    int "Display sleep timeout (seconds)"
    default 60
    range 10 600
    help
        Time in seconds before turning off the display completely.
        Set to 0 to disable sleep.

config RK_BACKLIGHT_NORMAL
    int "Normal backlight brightness (0-255)"
    default 100
    range 0 255
    help
        Backlight brightness level during normal operation (0-255).
        Default 100 is approximately 40% brightness.

config RK_BACKLIGHT_DIM
    int "Dimmed backlight brightness (0-255)"
    default 25
    range 0 255
    help
        Backlight brightness level when dimmed (0-255).
        Default 25 is approximately 10% brightness.

endmenu

menu "Power Profiling"

config RK_PERF_LOG
    bool "Log wake-up counters and power-manager statistics around display sleep"
    default n
    help
        Development aid for the display-sleep power work (issue #45). Counts how often each
        periodic timer and housekeeping loop wakes the CPU while the screen is off, and prints
        the rates plus ESP-IDF's power-manager statistics (time in each power mode, light-sleep
        entries and rejections) each time the display wakes. Off in release builds; enable
        together with CONFIG_PM_PROFILING (see idf_app/sdkconfig.profiling).

endmenu
```
